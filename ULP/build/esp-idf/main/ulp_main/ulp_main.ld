
/* ULP variable definitions for the linker.
 * This file is generated automatically by esp32ulp_mapgen.py utility.
 */
PROVIDE ( ulp___stack_top = 0x50001000 );
PROVIDE ( ulp_gpio_level_previous_a = 0x5000012c );
PROVIDE ( ulp_irq_vector = 0x50000010 );
PROVIDE ( ulp_main = 0x50000046 );
PROVIDE ( ulp_reset_vector = 0x50000000 );
PROVIDE ( ulp_RTCCNTL = 0x50008000 );
PROVIDE ( ulp_SENS = 0x5000c800 );
PROVIDE ( ulp_ulp_riscv_halt = 0x50000102 );
PROVIDE ( ulp_ulp_riscv_rescue_from_monitor = 0x500000e2 );
PROVIDE ( ulp_ulp_riscv_wakeup_main_processor = 0x500000f6 );
